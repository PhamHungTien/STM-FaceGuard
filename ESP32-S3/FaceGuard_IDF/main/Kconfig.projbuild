## ESP32-S3/FaceGuard_IDF/main/Kconfig.projbuild
```kconfig
menu "FaceGuard Compatibility"

config TIE728_BOOST
    bool "Force TIE728 path in ESP-DL (IDF v6.0 fix)"
    default y if IDF_TARGET_ESP32S3
    help
        CONFIG_TIE728_BOOST was removed from IDF v6.0 Kconfig but ESP-DL 3.2.4
        still references it via #if CONFIG_TIE728_BOOST in dl_tool_cache.cpp.
        Enabling this forces the correct TIE728 vector instruction path on
        ESP32-S3 and avoids a compile error caused by an outdated struct
        initialiser in the fallback #else branch.

endmenu
```

## ESP32-S3/FaceGuard_IDF/sdkconfig.defaults
```kconfig
# FaceGuard — ESP32-S3 N16R8 (16MB Flash, 8MB OPI PSRAM)
# For ESP-IDF v5.x / v6.x

# Flash size
CONFIG_ESPTOOLPY_FLASHSIZE_16MB=y

# PSRAM — OPI for N16R8 (8MB Octal)
CONFIG_SPIRAM=y
CONFIG_SPIRAM_TYPE_AUTO=y
CONFIG_SPIRAM_SPEED_80M=y

# Partition table (custom)
CONFIG_PARTITION_TABLE_CUSTOM=y
CONFIG_PARTITION_TABLE_CUSTOM_FILENAME="partitions.csv"

# Stack
CONFIG_ESP_MAIN_TASK_STACK_SIZE=8192

# Force TIE728 vector path in ESP-DL (IDF v6.0 compatibility)
CONFIG_TIE728_BOOST=y

# SPIFFS for face feature database partition
CONFIG_SPIFFS_MAX_PARTITIONS=2
```
